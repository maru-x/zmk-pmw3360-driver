## Kconfig
```kconfig
# Sensor data simulator
#
# Copyright (c) 2019 Nordic Semiconductor
#
# SPDX-License-Identifier: LicenseRef-Nordic-5-Clause
#

menuconfig PMW3360
    bool "PMW3360 mouse optical sensor"
  select SPI
    help
      Enable PMW3360 mouse optical sensor.

if PMW3360

config PMW3360_SWAP_XY
  bool "Swap the X/Y axis of PMW3360 sensor"

config PMW3360_INVERT_X
  bool "Invert the X axis of PMW3360 sensor"

config PMW3360_INVERT_Y
  bool "Invert the Y axis of PMW3360 sensor"

config PMW3360_REPORT_INTERVAL_MIN
	int "PMW3360's default minimum report rate"
	default 0
	help
	  Default minimum report interval in milliseconds.
		Slow down input reporting for hid queue over the air.
		Turn value down to 8ms to get sharp response if use with USB only.

config PMW3360_SMART_ALGORITHM
  bool "Enable an algorithm of PMW3360 to enhance surface coverage"
  default y
  help
    Enable the integration of the smart algorithm as the datasheet implementation.
    The algorithm is used to extend the tracking acrocss a wider range of surfaces
    such as graniles and tiles.

config PMW3360_RUN_DOWNSHIFT_TIME_MS
    int "PMW3360's default RUN mode downshift time"
    default 128
    range 13 3264
    help
      Default RUN mode downshift down time in milliseconds.
      Time after which sensor goes from RUN to REST1 mode.

config PMW3360_REST1_DOWNSHIFT_TIME_MS
    int "PMW3360's default REST1 mode downshift time"
    default 5000
    help
      Default REST1 mode downshift down time in milliseconds.
      Time after which sensor goes from REST1 to REST2 mode.

config PMW3360_REST2_DOWNSHIFT_TIME_MS
    int "PMW3360's default REST2 mode downshift time"
    default 17000
    help
      Default REST2 mode downshift down time in milliseconds.
      Time after which sensor goes from REST2 to REST3 mode.

config PMW3360_REST1_SAMPLE_TIME_MS
    int "PMW3360's sample time in REST1 stage"
    default 40
    # range 10 2550
    help
      Default REST1 mode sample period in millisecond

config PMW3360_REST2_SAMPLE_TIME_MS
    int "PMW3360's sample time in REST2 stage"
    default 100
    # range 10 2550
    help
      Default REST2 mode sample period in millisecond.

config PMW3360_REST3_SAMPLE_TIME_MS
    int "PMW3360's sample time in REST3 stage"
    default 500
    # range 10 2550
    help
      Default REST2 mode sample period in millisecond.

module = PMW3360
module-str = PMW3360
source "${ZEPHYR_BASE}/subsys/logging/Kconfig.template.log_config"

endif #PMW3360
```

## dts/bindings/pixart,pmw3610.yml
```yaml
description: |
    This is a representation of the PMW3610 optical motion sensor

compatible: "pixart,pmw3610"

include: spi-device.yaml

properties:
    irq-gpios:
        type: phandle-array
        required: true

    # ここから追記 ↓↓
    automouse-layer:
        type: int
        required: true
        description: "Trackball 操作中に自動的にアクティブにするレイヤー番号"

    scroll-layers:
        type: int
        required: true
        description: "スクロールモード時に切り替えるレイヤー一覧"

    snipe-layers:
        type: int
        required: true
        description: "スナイプ（精密移動）モード時に切り替えるレイヤー一覧"
```
